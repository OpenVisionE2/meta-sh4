## conf/machine/cuberevo.conf
```bitbake
require conf/machine/include/cuberevo.inc

MACHINE_FEATURES += "twintuner cuberevo RCA YUV SCART"
```

## conf/machine/cuberevo_mini2.conf
```bitbake
require conf/machine/include/cuberevo.inc

MACHINE_FEATURES += "cuberevo_mini2 RCA YUV SCART"
```

## conf/machine/forever_3434hd.conf
```bitbake
require conf/machine/include/forever.inc

MACHINE_FEATURES += "forever_3434hd RCA"

RESELLERID = "29090300"
```

## conf/machine/forever_9898hd.conf
```bitbake
require conf/machine/include/forever.inc

MACHINE_FEATURES += "forever_9898hd ci SCART YUV"

RESELLERID = "29090200"
```

## conf/machine/ipbox9900.conf
```bitbake
require conf/machine/include/ipbox.inc

MACHINE_FEATURES += "twintuner fan ipbox9900 RCA YUV SCART"
```
